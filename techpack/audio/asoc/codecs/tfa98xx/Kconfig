## techpack/audio/asoc/codecs/tfa98xx/Kconfig
```kconfig
config SND_SOC_TFA9874
	tristate "NXP TFA9874A audio amplifier"
	help
	  Say Y here if you want to add support for the NXP TFA9874A audio
	  amplifier.

config SND_SOC_TFA9874_FOR_DAVI
	bool "Use the DAVI (MI2S TX hostless) path on TFA9874"
	depends on SND_SOC_TFA9874
	help
	  Route the smart amplifier voltage/current feedback through the
	  MI2S TX hostless DAI on the TFA9874 itself, instead of the
	  Tavil (WCD9340) slimbus_4 vifeedback path. raphael (Mi 9T Pro)
	  is wired this way in stock; enabling this makes the
	  msm_sm8150_dailink tfa_tx_hostless block compile.
```
